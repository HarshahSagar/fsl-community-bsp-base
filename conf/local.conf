## conf/local.conf
```bitbake
MACHINE ??= 'wandboard-quad'
DISTRO ?= 'poky'
PACKAGE_CLASSES ?= "package_rpm"
IMAGE_ROOTFS_SIZE = "921600"
IMAGE_FEATURES += "package-management dev-pkgs"
IMAGE_INSTALL += "autoconf automake binutils binutils-symlinks cpp cpp-symlinks gcc gcc-symlinks g++ g++-symlinks gettext make libstdc++ libstdc++-dev file coreutils"

EXTRA_IMAGE_FEATURES = "debug-tweaks ssh-server-openssh "
DISTRO_FEATURES_remove = "x11 wayland opengl gl directfb"
IMAGE_INSTALL_append = " kernel-modules gcc g++ binutils libgcc libgcc-dev libstdc++ libstdc++-dev libstdc++-staticdev \
autoconf automake ccache chkconfig glib-networking glibmm \
packagegroup-core-buildessential pkgconfig  \
boost cmake zlib glib-2.0 packagegroup-fsl-tools-testapps  \
    cpufrequtils \
    gdb \
    openssh-sftp-server \
    packagegroup-fsl-tools-testapps \
    packagegroup-fsl-tools-benchmark \
    imx-vpu \
    imx-test \    	
    qtbase-plugins \
    qtbase-tools \
    qtsensors \
    qtscript \
    qtwebsockets \
    qtserialport \
    dbus \
    i2c-tools \ 
    nodejs \
    nodejs-npm \
    nginx \
    sqlite \
    libconfig \
    wpa-supplicant \
    bcm4330-nvram-config \
"
RDEPENDS_packagegroup-core-full-cmdline-sys-services_remove = " lighttpd"
PREFERRED_PROVIDER_node = "nodejs"
PREFERRED_PROVIDER_node-native = "nodejs-native"

USER_CLASSES ?= "buildstats image-mklibs image-prelink"
PATCHRESOLVE = "noop"
BB_DISKMON_DIRS = "\
    STOPTASKS,${TMPDIR},1G,100K \
    STOPTASKS,${DL_DIR},1G,100K \
    STOPTASKS,${SSTATE_DIR},1G,100K \
    ABORT,${TMPDIR},100M,1K \
    ABORT,${DL_DIR},100M,1K \
    ABORT,${SSTATE_DIR},100M,1K" 
PACKAGECONFIG_append_pn-qemu-native = " sdl"
PACKAGECONFIG_append_pn-nativesdk-qemu = " sdl"
PACKAGECONFIG_append_pn-qtbase = " sql-sqlite"
PACKAGECONFIG_remove_pn-qtbase = " examples cups "

ASSUME_PROVIDED += "libsdl-native"
CONF_VERSION = "1"

BB_NUMBER_THREADS = '4'
PARALLEL_MAKE = '-j 1'

DL_DIR ?= "${BSPDIR}/downloads/"
ACCEPT_FSL_EULA = ""
```
